#include <Arduino.h>
#include <Wire.h>
#include <MCP45HVX1.h>

MCP45HVX1 digiPotOffset(0x3C);
MCP45HVX1 digiPotAmplitude(0x3D);

int sinus_wave[] = {
    0x7f, 0x80, 0x81, 0x81, 0x82, 0x83, 0x84, 0x85, 0x85, 0x86, 0x87, 0x88, 0x89, 0x89, 0x8a, 0x8b,
    0x8c, 0x8d, 0x8d, 0x8e, 0x8f, 0x90, 0x91, 0x91, 0x92, 0x93, 0x94, 0x95, 0x95, 0x96, 0x97, 0x98,
    0x98, 0x99, 0x9a, 0x9b, 0x9c, 0x9c, 0x9d, 0x9e, 0x9f, 0x9f, 0xa0, 0xa1, 0xa2, 0xa3, 0xa3, 0xa4,
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    0x79, 0x79, 0x7a, 0x7b, 0x7c, 0x7d, 0x7d, 0x7e 
};

const static unsigned int sinus_wave_len = sizeof(sinus_wave)/sizeof(int);

volatile unsigned int i = 0;
volatile int wiperOffset;
volatile int wiperAmplitute;
volatile int periodMicro;
HardwareTimer *MyTim;

void Update_IT_callback(void)
{
    if (i >= sinus_wave_len) {
        //Serial.print("break ");
        //Serial.println(i);
        i = 0;
    }
    analogWrite(PA4, sinus_wave[i]);
    i++;
}

void setup()
{
    Serial.begin(115200);
    Serial.println("Booting...");
    //Wire.setSDA(PB9);
    //Wire.setSCL(PB8);
    Wire.setSDA(PB7);
    Wire.setSCL(PB6);
    Wire.begin();

    pinMode(PB14, OUTPUT);
    pinMode(PB13, OUTPUT);
    pinMode(PB1, OUTPUT);


  MyTim = new HardwareTimer(TIM1);
  periodMicro = 1*sinus_wave_len; // 1 Hz
  MyTim->setOverflow(periodMicro, MICROSEC_FORMAT);
  MyTim->attachInterrupt(Update_IT_callback);
  MyTim->resume();

    //pinMode(PA5, OUTPUT);

    Serial.println("\nI2C Scanner");

    {
        byte error, address;
        int nDevices;

        Serial.println("Scanning...");

        nDevices = 0;
        for(address = 1; address < 127; address++ ) {
            // The i2c_scanner uses the return value of
            // the Write.endTransmisstion to see if
            // a device did acknowledge to the address.
            Wire.beginTransmission(address);
            error = Wire.endTransmission();

            if (error == 0) {
                Serial.print("I2C device found at address 0x");
                if (address<16)
                Serial.print("0");
                Serial.print(address,HEX);
                Serial.println("  !");

                nDevices++;
            } else if (error==4) {
                Serial.print("Unknown error at address 0x");
                if (address<16)
                Serial.print("0");
                Serial.println(address,HEX);
            }
        }
        if (nDevices == 0)
        Serial.println("No I2C devices found\n");
        else
        Serial.println("done\n");
    }
    

    digiPotOffset.begin();
    digiPotAmplitude.begin();

    wiperOffset = 198;
    wiperAmplitute = 128;

    Serial.println("\n----- Offset Wiper Register ----");
    Serial.print("readWiper: ");
    Serial.println(digiPotOffset.readWiper());

    Serial.print("writeWiper: ");
    digiPotOffset.writeWiper(wiperOffset);
    Serial.println(digiPotOffset.readWiper());

    delay(100);

    Serial.println("\n----- Amplitude Wiper Register ----");
    Serial.print("readWiper: ");
    Serial.println(digiPotAmplitude.readWiper());

    Serial.print("writeWiper: ");
    digiPotAmplitude.writeWiper(wiperAmplitute);
    Serial.println(digiPotAmplitude.readWiper());


    Serial.print("Sinus length: ");
    Serial.println(sizeof(sinus_wave)/sizeof(int));
}


bool out1 = false;
bool out2 = false;
bool out3 = false;

/*
 * +14V / -14V: O: 198 A: 223
 * +5V / -5V: O: 198 A: 128
 * +3.3V / -3.3V: O: 198 A: 88
 * +3.3V / 0V: O: 3 A: 43
 * +5.0V / 0V: O: 0 A: 67
 * +14V / 0V: O: 5 A: 162
 */

void loop() {
    /*
    Serial.println("Loop");
    digitalWrite(PA5, 1);
    delay(500);
    digitalWrite(PA5, 0);
    delay(500);
    */

    int recv;
    bool potOffset = false;
    bool potAmp = false;
    bool period = false;
    while (Serial.available() > 0)
    {
        recv = Serial.read();

        /* offset */
        if (recv == 'a') {
            wiperOffset += 1;
            potOffset = true;
        } else if (recv == 'b') {
            wiperOffset -= 1;
            potOffset = true;

        /* amplitute */
        } else if (recv == 'u') {
            wiperAmplitute += 1;
            potAmp = true;
        } else if (recv == 'd') {
            wiperAmplitute -= 1;
            potAmp = true;

        /* frequency */
        } else if (recv == 'q') {
            periodMicro /= 2;
            period = true;
        } else if (recv == 'w') {
            periodMicro *= 2;
            period = true;
        }

        if (potOffset) {
            digiPotOffset.writeWiper(wiperOffset);
        } else if (potAmp) {
            digiPotAmplitude.writeWiper(wiperAmplitute);
        } else if (period) {
            MyTim->setOverflow(periodMicro, MICROSEC_FORMAT);
        }

        Serial.print("O: ");
        Serial.print(digiPotOffset.readWiper());
        Serial.print(" A: ");
        Serial.print(digiPotAmplitude.readWiper());
        Serial.print(" F: ");
        Serial.println(periodMicro);
    }
   //Serial.print("test!\n");
   //delay(100);

    out1 = !out1;
    out2 = !out2;
    out3 = !out3;

    digitalWrite(PB14, out1);
    digitalWrite(PB13, out1);
    digitalWrite(PB1, out1);
}